## config/west.yml
```yaml
manifest:
  remotes:
    - name: zmkfirmware
      url-base: https://github.com/zmkfirmware
  #additional module
    - name: petejohanson
      url-base: https://github.com/petejohanson
    - name: gpeye
      url-base: https://github.com/GPeye
    - name: mctechnology17
      url-base: https://github.com/mctechnology17
    - name: kevinpastor
      url-base: https://github.com/kevinpastor
    - name: m165437
      url-base: https://github.com/M165437
    - name: s6t
      url-base: https://github.com/s6t
    - name: infely
      url-base: https://github.com/infely
    - name: penguinchat
      url-base: https://github.com/penguinchat
    - name: englmaxi
      url-base: https://github.com/englmaxi
  projects:
    - name: zmk
      remote: zmkfirmware
      revision: v0.3
      import: app/west.yml
  #additional module (pinned to tested commits; bump deliberately)
    - name: hammerbeam-slideshow
      remote: gpeye
      revision: 9c16436efa4c87d19e2e4558927969c7ddd5851d
    - name: zmk-nice-oled
      remote: mctechnology17
      revision: 46f824abb2bd41f1287c5c68abd14122af6042a3
    - name: nice-view-elemental
      remote: kevinpastor
      revision: 69c2ecd56b0b870ddb94b79110ef5a2152ca4a3a
    - name: nice-view-gem
      remote: m165437
      revision: 0a50fe209d929c916c5664c6affd0f4977c6b012
    - name: zmk-shield-nice-view-cats
      remote: s6t
      revision: 6835afe70678f3fc6e4dfb9b0d0ddbf9298c409a
    - name: nice-view-battery
      remote: infely
      revision: a9ebccd6309e21525577dc35fea4eb107bda7cd1
    - name: zmk-dongle-screen
      remote: penguinchat
      revision: d878027ea6da2551fa0b455041dac1c90e9aed42
    - name: zmk-for-PandaKB.com-
      remote: penguinchat
      revision: ad4125a9c46121048ee4bb189188817746afe91f
    - name: zmk-dongle-display
      remote: englmaxi
      revision: c6c4be11c5ede722086a2a1f355cec9c101b9390
  self:
    path: config
```
